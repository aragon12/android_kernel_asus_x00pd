//hebiao@wind-mobi.com 20180111 begin
/*
 * Copyright (c) 2014-2015, The Linux Foundation. All rights reserved.
 *
 * This program is free software; you can redistribute it and/or modify
 * it under the terms of the GNU General Public License version 2 and
 * only version 2 as published by the Free Software Foundation.
 *
 * This program is distributed in the hope that it will be useful,
 * but WITHOUT ANY WARRANTY; without even the implied warranty of
 * MERCHANTABILITY or FITNESS FOR A PARTICULAR PURPOSE.  See the
 * GNU General Public License for more details.
 */

/*
 * This program is free software; you can redistribute it and/or modify
 * it under the terms of the GNU General Public License version 2 and
 * only version 2 as published by the Free Software Foundation.
 *
 * This program is distributed in the hope that it will be useful,
 * but WITHOUT ANY WARRANTY; without even the implied warranty of
 * MERCHANTABILITY or FITNESS FOR A PARTICULAR PURPOSE.  See the
 * GNU General Public License for more details.
 */

/*---------------------------------------------------------------------------
 * This file is autogenerated file using gcdb parser. Please do not edit it.
 * Update input XML file to add a new entry or update variable in this file
 * VERSION = "1.0"
 *---------------------------------------------------------------------------*/
&mdss_mdp {
	dsi_jdf_lianovation_st7703_720p_video: qcom,dsi_jdf_lianovation_st7703_720p_video {
		qcom,mdss-dsi-panel-name = "st7703 720p video mode dsi panel";
		qcom,mdss-dsi-panel-controller = <&mdss_dsi0>;
		qcom,mdss-dsi-panel-type = "dsi_video_mode";
		qcom,mdss-dsi-panel-destination = "display_1"; //
		qcom,mdss-dsi-panel-framerate = <62>;
		qcom,mdss-dsi-virtual-channel-id = <0>;  //
		qcom,mdss-dsi-stream = <0>;	//
		qcom,mdss-dsi-panel-width = <720>;
		qcom,mdss-dsi-panel-height = <1440>;
		qcom,mdss-dsi-h-front-porch = <60>;
		qcom,mdss-dsi-h-back-porch = <55>;  //
		qcom,mdss-dsi-h-pulse-width = <20>; //horizontal_sync_active
		qcom,mdss-dsi-h-sync-skew = <0>;   //
		qcom,mdss-dsi-v-back-porch = <17>;//
		qcom,mdss-dsi-v-front-porch = <21>;//
		qcom,mdss-dsi-v-pulse-width = <4>; //
		qcom,mdss-dsi-h-left-border = <0>; //
		qcom,mdss-dsi-h-right-border = <0>;//
		qcom,mdss-dsi-v-top-border = <0>; //
		qcom,mdss-dsi-v-bottom-border = <0>; //
		qcom,mdss-dsi-bpp = <24>; //
		qcom,mdss-dsi-color-order = "rgb_swap_rgb";
		qcom,mdss-dsi-underflow-color = <0xff>; //
		qcom,mdss-dsi-border-color = <0>; //
		qcom,mdss-dsi-on-command = [39 01 00 00 00 00 04 B9 F1 12 83 
			39 01 00 00 00 00 1c BA 33 81 05 F9 0e 0e 20 00 00 00 00 00 00 00 44 25 00 91 0a 00 00 02 4F 01 00 00 37 
			39 01 00 00 00 00 05 B8 76 22 20 03 
			39 01 00 00 00 00 0b B3 0C 10 05 05 03 FF 00 00 00 00 
			39 01 00 00 00 00 0a C0 73 73 50 50 00 00 08 70 00 
			39 01 00 00 00 00 02 BC 4F 
			39 01 00 00 00 00 02 CC 0B 
			39 01 00 00 00 00 02 B4 80 
			39 01 00 00 00 00 04 B2 F0 12 F0 //30->F0
			39 01 00 00 00 00 0f E3 07 07 0B 0B 03 0B 00 00 00 00 FF 00 C0 10 
			39 01 00 00 00 00 0d C1 53 C0 2A 2A 77 F1 FF FF EE EE EE EE 
			39 01 00 00 00 00 06 C6 02 40 CF 7F 00 
			39 01 00 00 00 00 03 B5 19 19 
			39 01 00 00 00 00 03 B6 3B 3B 
			39 01 00 00 00 00 04 BF 02 11 00 
			39 01 00 00 00 00 40 E9 82 10 09 00 00 C1 89 12 31 23 47 87 C1 89 47 2A 00 00 0C 00 00 00 00 00 0C 00 00 00 88 20 46 02 88 88 88 88 88 88 FF 88 31 57 13 88 88 88 88 88 88 FF 00 00 00 00 00 00 00 00 00 00 00 00 00 
			39 01 00 00 00 00 3e EA 00 1A 00 00 00 00 02 00 00 00 00 00 8F 13 31 75 88 88 88 88 88 88 F8 8F 02 20 64 88 88 88 88 88 88 F8 23 00 00 00 00 00 00 00 00 00 00 00 00 00 00 00 00 00 00 00 00 00 00 00 00 00 00 
			39 01 00 00 00 00 23 E0 00 07 0C 2B 31 38 40 3C 06 0C 0D 11 13 11 13 13 1A 00 07 0C 2B 31 38 40 3C 06 0C 0D 11 13 11 13 13 1A
//			39 01 00 00 00 00 03 C8 10 01 
//			39 01 00 00 00 00 02 C7 A0 
//			39 01 00 00 00 00 02 51 FF 
//			39 01 00 00 00 00 02 55 02 
//			39 01 00 00 00 00 02 53 24 
			05 01 00 00 78 00 02 11 00
//			39 01 00 00 00 00 0a C9 2E 2B 2B 2A 26 25 24 23 20 
			05 01 00 00 00 00 02 29 00];
		qcom,mdss-dsi-off-command = [05 01 00 00 00 00 02 28 00
					05 01 00 00 78 00 02 10 00];
		qcom,mdss-dsi-on-command-state = "dsi_lp_mode"; 
		qcom,mdss-dsi-off-command-state = "dsi_hs_mode";
		qcom,mdss-dsi-h-sync-pulse = <1>;
		qcom,mdss-dsi-traffic-mode = "burst_mode";
		qcom,mdss-dsi-lane-map = "lane_map_0123";
		qcom,mdss-dsi-bllp-eof-power-mode;
		qcom,mdss-dsi-bllp-power-mode;
		qcom,mdss-dsi-lane-0-state;
		qcom,mdss-dsi-lane-1-state;
		qcom,mdss-dsi-lane-2-state;
		qcom,mdss-dsi-lane-3-state;
		qcom,mdss-dsi-panel-timings = [88 1E 12 00 42 46 18 20 16 03 04 00];
		qcom,mdss-dsi-t-clk-post = <0x04>;
		qcom,mdss-dsi-t-clk-pre = <0x1B>;
		qcom,mdss-dsi-bl-min-level = <1>;
		qcom,mdss-dsi-bl-max-level = <4095>;
		qcom,esd-check-enabled;
		//qcom,mdss-dsi-hfp-power-mode;
		//qcom,mdss-dsi-hbp-power-mode;
		//qcom,mdss-dsi-hsa-power-mode;
		qcom,mdss-dsi-panel-status-command = [14 01 00 01 05 00 01 09
		14 01 00 01 05 00 01 68];
		qcom,mdss-dsi-panel-status-command-state = "dsi_lp_mode";
		qcom,mdss-dsi-panel-status-check-mode = "reg_read";
		qcom,mdss-dsi-panel-status-read-length = <1 1>;
		qcom,mdss-dsi-panel-max-error-count = <2>;
		qcom,mdss-dsi-panel-status-value = <0x80> , <0xC0>;	
		qcom,mdss-dsi-dma-trigger = "trigger_sw";
		qcom,mdss-dsi-mdp-trigger = "none";
		qcom,mdss-dsi-bl-pmic-control-type = "bl_ctrl_wled";
		qcom,mdss-dsi-reset-sequence = <1 20>, <0 1>, <1 20>;
	};
};
//hebiao@wind-mobi.com 20180111 end