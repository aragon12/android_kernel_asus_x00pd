
qcom,3308404_wind_a305cos_3000mah_averaged_masterslave_feb26th2018 {
	/* #3308404_Wind_A305cos_3000mAh_averaged_MasterSlave_Feb26th2018*/
	qcom,max-voltage-uv = <4350000>;
	qcom,nom-batt-capacity-mah = <3000>;
	qcom,batt-id-kohm = <51>;
	qcom,battery-beta = <3435>;
	qcom,battery-type = "3308404_wind_a305cos_3000mah_averaged_masterslave_feb26th2018";
	qcom,chg-rslow-comp-c1 = <4358848>;
	qcom,chg-rslow-comp-c2 = <8367117>;
	qcom,chg-rs-to-rslow = <1058563>;
	qcom,chg-rslow-comp-thr = <0xBD>;
	qcom,fg-cc-cv-theshold-mv = <4330>;
	qcom,checksum = <0xA5E1>;
	qcom,gui-version = "PMI8950GUI - 2.0.0.16";
	qcom,fg-profile-data = [
		 AE 83 4D 75 
		 67 7A 55 6E 
		 37 83 41 78 
		 56 85 40 82 
		 E3 81 40 A0 
		 44 C4 DA D1 
		 67 0F E6 83 
		 57 7C 73 80 
		 9B 75 35 83 
		 B1 79 AA 87 
		 2D 88 24 82 
		 A8 9B 33 C4 
		 5E D2 6A 0E 
		 D1 0B 49 5A 
		 14 70 B2 FD 
		 19 3D 91 3E 
		 CF 40 00 00 
		 82 46 5C 40 
		 C5 3E 00 00 
		 00 00 00 00 
		 00 00 00 00 
		 C2 70 3A 6B 
		 CE 64 17 8A 
		 6E 7C 82 71 
		 62 74 A8 72 
		 F7 75 A5 6A 
		 BE 4D 5E 99 
		 36 62 60 20 
		 5E A0 71 0C 
		 28 00 FF 36 
		 F0 11 30 03 
		 00 00 00 0C 
	];
};
