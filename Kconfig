## Kconfig
```kconfig
#
# For a description of the syntax of this configuration file,
# see Documentation/kbuild/kconfig-language.txt.
#
mainmenu "Linux/$ARCH $KERNELVERSION Kernel Configuration"

config SRCARCH
	string
	option env="SRCARCH"

source "arch/$SRCARCH/Kconfig"

#hebiao@wind-mobi.com 20171126 begin
config WIND_DEVICE_INFO
	bool "CONFIG_WIND_DEVICE_INFO"
	default n
	help
		Select y or n
#hebiao@wind-mobi.com 20171126 end
#liqiang@wind-mobi.com 20180207 begin
config WIND_PRO_A306
	bool "CONFIG_WIND_PRO_A306"
	default n
	help
		Select y or n
config WIND_PRO_E300LWW
	bool "CONFIG_WIND_PRO_E300LWW"
	default n
	help
		Select y or n		
#liqiang@wind-mobi.com 20180207 end
```

## drivers/misc/wind_driver/Kconfig
```kconfig
## lihaiyan@wind-mobi.com 20171101 +++


config WIND_DEVICE_INFO
	bool "CONFIG_WIND_DEVICE_INFO"
	default y
	help
		Select y or n

#source "drivers/misc/wind_driver/fingerprint/Kconfig"
source "drivers/misc/wind_driver/fingerprint/leadcore/Kconfig"
source "drivers/misc/wind_driver/fingerprint/microarray/Kconfig"
source "drivers/misc/wind_driver/fingerprint/sunwave/Kconfig"


## lihaiyan@wind-mobi.com 20171101 ---
```
